## zh/固件_统一优化版_1.3.2/ESP32C3固件/components/wifi_transport/Kconfig
```kconfig
menu "VQF WiFi Transport"

    config WIFI_SSID
        string "WiFi SSID"
        default ""
        help
            要连接的 WiFi 热点名称

    config WIFI_PASSWORD
        string "WiFi Password"
        default ""
        help
            WiFi 热点密码

endmenu
```
